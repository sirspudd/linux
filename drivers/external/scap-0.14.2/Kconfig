## drivers/external/scap-0.14.2/Kconfig
```kconfig
menu "External modules"

config SYSDIG_SCAP
        tristate "SYSDIG SCAP driver"
        help
          Compiles the sysdig kernel module

endmenu
```
